/********************************************************************
  Copyright: 2016-2021 www.corvin.cn ROS小课堂
  Description:锂电池输出电流检测功能,使用电阻分压方式检测锂电池输出电压,
    然后根据电压和电量对应关系,使用查表法可以得知剩余电量.
  Author: corvin
  History: 
    20190927: init this file;
    20200329:增加电池电量剩余百分比检测功能,使用电压和电量对应关系实现.
    20200410:更新读取电流传感器的模拟引脚值方法,使数据更稳定.
    20200516:去掉A1引脚上的电流检测功能.
********************************************************************/
#define  AREF_VOL      3.3  //参考电压
#define  VOLTAGE_PIN   A0   //测量电压时接的模拟引脚

#define  ADC_SENS        1024
//#define  ADC_RESOLUTION  12

//初始化电压和电量百分比之间对应关系的数组,方便后面使用查表法查询电量百分比.
//注意这里的电压只针对21V 18650锂电池组适用,其他锂电池不可用.
const float BAT_PERCENT[100] = {
  //[10]  [9]    [8]    [7]    [6]    [5]    [4]    [3]    [2]    [1]
  21.00, 20.80, 20.70, 20.60, 20.55, 20.53, 20.50, 20.47, 20.44, 20.39, //电量100% ~ 91%对应电压
  20.38, 20.33, 20.29, 20.26, 20.22, 20.19, 20.16, 20.13, 20.10, 20.08, //电量 90% ~ 81%对应电压
  20.06, 19.99, 19.98, 19.96, 19.89, 19.87, 19.85, 19.80, 19.73, 19.71, //电量 80% ~ 71%对应电压
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  17.53, 17.29, 17.09, 16.92, 16.72, 16.51, 16.27, 16.07, 15.89, 15.69, //电量 10% ~  1%对应电压
};


/******************************************
   Description:初始化电压传感器的引脚模式.
 ******************************************/
void initVoltageDetect(void)
{
  pinMode(VOLTAGE_PIN, INPUT);
  analogReference(AR_DEFAULT); //调用板载3.3V默认基准源
  //analogReadResolution(ADC_RESOLUTION);
}

/**********************************************************
  Description:使用电阻分压方式测锂电池当前输出电压,原理图如下：
           -----    A0    ------
    BAT---| 39K |---!----| 4.7K |----GND
           -----          ------
    可以得知A0-GND之间为测得分压,所以它占总电压4.7/4.7+39,
    因此,测得的ADC值需要乘以4.7+39/4.7就为当前BAT的总电压.
    对于ADC采样值的获取仍然是使用算术平均滤波算法,过滤随机干扰,
    这样获取的ADC采样值更为稳定,准确,然后再计算电压值.
 **********************************************************/
static float detectVoltage(void)
{
  byte cnt = 30;
  int tmp = 0;
  int maxVal = 0;
  int minVal = 0;
  float voltage = 0.0;
  float sum = 0.0;

  //读取数据,并在此过程中记录读取到的最大值和最小值
  for (byte i = 0; i < cnt; i++)
  {
    tmp = analogRead(VOLTAGE_PIN);
    sum += tmp;
    if (0 == i) //将读取到的第一个值作为最大值和最小值初始值
    {
      maxVal = minVal = tmp;
    }

    //判断当前值是否比最大值还要大,那就将读取到值作为最大值
    if (tmp > maxVal)
    {
      maxVal = tmp;
    }
    //判断当前值是否比最小值还要小,那就将读取到值作为最小值
    if (tmp < minVal)
    {
      minVal = tmp;
    }
  }

  //使用算术平均滤波算法得到ADC采样数据,过滤随机干扰值
  sum = sum - maxVal - minVal; //去掉一个最大值和最小值
  sum = sum / (cnt - 2.0);
  //Serial.println(sum);

  //根据电阻分压原理计算锂电池输出电压
  //(39 + 4.7)/4.7 = 9.29787234
  voltage = sum / ADC_SENS * AREF_VOL * 9.297;
  return voltage;
}

/******************************************************
   Description:根据检测到的电池电压,配合百分比数组就可以得到
     当前锂电池电量百分比了.
*******************************************************/
byte detectBatPercent(void)
{
  float voltage = 0.0;
  byte percent = 0;

  voltage = detectVoltage();
  //Serial.println(voltage, 2);
  for (percent = 0; percent < 100; percent++)
  {
    if (voltage >= BAT_PERCENT[percent])
    {
      break;
    }
  }

  percent = 100 - percent;
  return percent;
}
